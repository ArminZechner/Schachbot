#include "Display.h"
// 'b_Tower', 40x40px
const unsigned char epd_bitmap_b_tower [] PROGMEM = {
	0xff, 0x01, 0xff, 0x80, 0x7f, 0xff, 0x01, 0xff, 0x80, 0x7f, 0xff, 0x01, 0xff, 0x80, 0x7f, 0xff, 
	0x01, 0xff, 0x80, 0x7f, 0xff, 0x01, 0xff, 0x80, 0x7f, 0xff, 0xff, 0xff, 0xff, 0xff, 0xff, 0xff, 
	0xff, 0xff, 0xff, 0xff, 0xff, 0xff, 0xff, 0xff, 0xff, 0xff, 0xff, 0xff, 0xff, 0xff, 0xff, 0xff, 
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	0xff, 0xff, 0xff, 0xff, 0xff, 0xff, 0xff, 0xff
};
// 'b_bishop', 40x40px
const unsigned char epd_bitmap_b_bishop [] PROGMEM = {
	0x00, 0x00, 0x3e, 0x00, 0x00, 0x00, 0x00, 0x3e, 0x00, 0x00, 0x00, 0x00, 0x3e, 0x00, 0x00, 0x00, 
	0x01, 0xff, 0x80, 0x00, 0x00, 0x01, 0xff, 0x80, 0x00, 0x00, 0x01, 0xff, 0x80, 0x00, 0x00, 0x01, 
	0xff, 0x80, 0x00, 0x00, 0x01, 0xff, 0x80, 0x00, 0x00, 0x00, 0x3e, 0x00, 0x00, 0x00, 0x00, 0x3e, 
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	0xff, 0xff, 0xff, 0xff, 0xff, 0xff, 0xff, 0xff
};
// 'b_horse', 40x40px
const unsigned char epd_bitmap_b_horse [] PROGMEM = {
	0x06, 0x0f, 0x80, 0x00, 0x00, 0x06, 0x0f, 0x80, 0x00, 0x00, 0x06, 0x0f, 0x80, 0x00, 0x00, 0x07, 
	0xcf, 0xf3, 0xe0, 0x00, 0x07, 0xcf, 0xf3, 0xe0, 0x00, 0x07, 0xff, 0xff, 0xff, 0x00, 0x07, 0xff, 
	0xff, 0xff, 0x00, 0x07, 0xff, 0xff, 0xff, 0x00, 0x3f, 0xff, 0xff, 0xff, 0xc0, 0x3f, 0xff, 0xff, 
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	0xff, 0xff, 0xff, 0xff, 0xff, 0xff, 0xff, 0xff
};
// 'b_king', 40x40px
const unsigned char epd_bitmap_b_king [] PROGMEM = {
	0x00, 0x00, 0x00, 0x00, 0x00, 0x00, 0x00, 0x00, 0x00, 0x00, 0x00, 0x00, 0x00, 0x00, 0x00, 0x00, 
	0x00, 0x3e, 0x00, 0x00, 0x00, 0x00, 0x3e, 0x00, 0x00, 0x00, 0x01, 0xff, 0x80, 0x00, 0x00, 0x01, 
	0xff, 0x80, 0x00, 0x00, 0x01, 0xff, 0x80, 0x00, 0x00, 0x07, 0xff, 0xf0, 0x00, 0x00, 0x07, 0xff, 
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	0xff, 0xf0, 0x00, 0x00, 0x07, 0xff, 0xf0, 0x00
};
// 'b_koenigin', 40x40px
const unsigned char epd_bitmap_b_koenigin [] PROGMEM = {
	0x00, 0x00, 0x3e, 0x00, 0x00, 0x00, 0x00, 0x3e, 0x00, 0x00, 0x00, 0x00, 0x3e, 0x00, 0x00, 0x00, 
	0xf9, 0xff, 0x8f, 0x80, 0x00, 0xf9, 0xff, 0x8f, 0x80, 0x07, 0xff, 0xff, 0xff, 0xe0, 0x07, 0xff, 
	0xff, 0xff, 0xe0, 0x07, 0xff, 0xff, 0xff, 0xe0, 0x07, 0xff, 0xff, 0xff, 0xe0, 0x07, 0xff, 0xff, 
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	0xff, 0xff, 0xfc, 0x1f, 0xff, 0xff, 0xff, 0xfc
};
// 'b_pawn', 40x40px
const unsigned char epd_bitmap_b_pawn [] PROGMEM = {
	0x00, 0x07, 0xff, 0xf0, 0x00, 0x00, 0x07, 0xff, 0xf0, 0x00, 0x00, 0x07, 0xff, 0xf0, 0x00, 0x00, 
	0x3f, 0xff, 0xfc, 0x00, 0x00, 0x3f, 0xff, 0xfc, 0x00, 0x00, 0xff, 0xff, 0xff, 0x80, 0x00, 0xff, 
	0xff, 0xff, 0x80, 0x00, 0xff, 0xff, 0xff, 0x80, 0x00, 0xff, 0xff, 0xff, 0x80, 0x00, 0xff, 0xff, 
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	0xff, 0xff, 0xfc, 0x1f, 0xff, 0xff, 0xff, 0xfc
};

// Array of all bitmaps for convenience. (Total bytes used to store images in PROGMEM = 864)
const int epd_bitmap_allArray_LEN = 6;
const unsigned char* epd_bitmap_allArray[6] = {
	epd_bitmap_b_pawn,
	epd_bitmap_b_tower,
	epd_bitmap_b_horse,
	epd_bitmap_b_bishop,
	epd_bitmap_b_koenigin,
	epd_bitmap_b_king
};

Display::Display(){
       //this->display = display;
       tft.begin();
       tft.init();
       tft.setRotation(1);
       tft.setTextFont(1);
       selectedFields[0].x = 'X';
       selectedFields[0].y = 'X';
       selectedFields[1].x = 'X';
       selectedFields[1].y = 'X';
}
void Display::setSelectedFields(Koordinate field1, Koordinate field2){
       selectedFields[0] = field1;
       selectedFields[1] = field2;
}
void Display::setChessBoard(char soll_schachbrett[SCHACHBRETT_SIZE_Y][SCHACHBRETT_SIZE_Y],
                            char soll_schachbrettFriedhof[2][SCHACHBRETT_SCHLAGBREITE][SCHACHBRETT_SIZE_Y]){
    memcpy(
        this->soll_schachbrett,
        soll_schachbrett,
        sizeof(this->soll_schachbrett)
    );

    memcpy(
        this->soll_schachbrettFriedhof,
        soll_schachbrettFriedhof,
        sizeof(this->soll_schachbrettFriedhof)
    );
}
void Display::setMessage(String message){
        this->message = message;
}
void Display::setGameMode(bool gameMode){
    this->gameMode = gameMode;
}
void Display::printInformationBoard(){
    displayMode = DISPLAY_MODE::infoBoard;
    if(gameMode == GAMEMODE::roboter){
    tft.fillScreen(TFT_GREEN);
    }
    else{
    tft.fillScreen(TFT_SKYBLUE);
    }
    tft.setTextColor(TFT_WHITE);
    tft.setTextSize(10);

    tft.drawChar(selectedFields[0].x, 100, 40);
    tft.drawChar(selectedFields[0].y, 180, 40);
    tft.drawChar(selectedFields[1].x, 260, 40);
    tft.drawChar(selectedFields[1].y, 340, 40);

    tft.fillRect(100, 95, 38, 10, TFT_WHITE);
    tft.fillRect(180, 95, 38, 10, TFT_WHITE);
    tft.fillRect(260, 95, 38, 10, TFT_WHITE);
    tft.fillRect(340, 95, 38, 10, TFT_WHITE);

    tft.setCursor(10,130);
    tft.setTextSize(4);
    tft.print(message);
}
int Display::getWhiteOrBlack(int figur) {
    if(figur == e_figuren::whitePawnQueen) {
        return Color::white;
    }
    else if(figur == e_figuren::blackPawnQueen) {
        return Color::black;
    }
    if (figur >= e_figuren::whitePawn &&
        figur <= e_figuren::whiteKing) {
        return Color::white;
    }
    else {
        return Color::black;
    }
}
int getPieceWithOutColor(int p) {
    if (p == e_figuren::empty) {
        return empty;
    }
    // Ein umgewandelter Bauer wird als Dame dargestellt (Koenigin-Bitmap).
    // Die richtige Farbe kommt weiterhin aus getWhiteOrBlack().
    if (p == e_figuren::whitePawnQueen ||
        p == e_figuren::blackPawnQueen) {
        return e_figuren::whiteQueen;
    }
    if (p >= e_figuren::whitePawn &&
        p <= e_figuren::whiteKing) {
        return p;
    }
    else {
        return p - 6;
    }
}
void Display::printChessfield(){
    displayMode = DISPLAY_MODE::chessBoard;
    bool schachMuster = false;

    for(int y = 0; y < 8; y++){
        for(int x = 0; x < 2; x++){
            schachMuster ? tft.fillRect(FIELD_SIZE_X * x, FIELD_SIZE_Y * y, FIELD_SIZE_X, FIELD_SIZE_Y, tft.color565(160, 190, 220)) :
            tft.fillRect(FIELD_SIZE_X * x, FIELD_SIZE_Y * y, FIELD_SIZE_X, FIELD_SIZE_Y, tft.color565(220, 235, 250));
            
            schachMuster ? tft.fillRect(FIELD_SIZE_X * (x + 10), FIELD_SIZE_Y * y, FIELD_SIZE_X, FIELD_SIZE_Y, tft.color565(190, 150, 130)) :
            tft.fillRect(FIELD_SIZE_X * (x + 10), FIELD_SIZE_Y * y, FIELD_SIZE_X, FIELD_SIZE_Y, tft.color565(240, 220, 200));
            if(soll_schachbrettFriedhof[0][x][y] != e_figuren::empty){
            tft.drawBitmap(x*FIELD_SIZE_X, y*FIELD_SIZE_Y, epd_bitmap_allArray[getPieceWithOutColor(soll_schachbrettFriedhof[0][x][y])], 40, 40, getWhiteOrBlack(soll_schachbrettFriedhof[0][x][y]) ? TFT_BLACK : TFT_WHITE);
            }
            if(soll_schachbrettFriedhof[1][x][y] != e_figuren::empty){
            tft.drawBitmap((x+10)*FIELD_SIZE_X, y*FIELD_SIZE_Y, epd_bitmap_allArray[getPieceWithOutColor(soll_schachbrettFriedhof[1][x][y])], 40, 40, getWhiteOrBlack(soll_schachbrettFriedhof[1][x][y]) ? TFT_BLACK : TFT_WHITE);
            }
            schachMuster = !schachMuster;
        }
        schachMuster = !schachMuster;
    }
    for(int y = 0; y < 8; y++){
        for(int x = 2; x < 10; x++){
            schachMuster ? tft.fillRect(FIELD_SIZE_X * x, FIELD_SIZE_Y * y, FIELD_SIZE_X, FIELD_SIZE_Y, tft.color565(115, 149, 82)) :
            tft.fillRect(FIELD_SIZE_X * x, FIELD_SIZE_Y * y, FIELD_SIZE_X, FIELD_SIZE_Y, tft.color565(235, 236, 208));
            if(soll_schachbrett[x-2][y] != e_figuren::empty){
            tft.drawBitmap(x*FIELD_SIZE_X, y*FIELD_SIZE_Y, epd_bitmap_allArray[getPieceWithOutColor(soll_schachbrett[x-2][y])], 40, 40, getWhiteOrBlack(soll_schachbrett[x-2][y]) ? TFT_BLACK : TFT_WHITE);
            }
            schachMuster = !schachMuster;
        }
        schachMuster = !schachMuster;
    }
}